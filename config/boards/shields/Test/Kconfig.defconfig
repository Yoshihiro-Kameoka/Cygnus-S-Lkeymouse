## config/boards/shields/Test/Kconfig.defconfig
```kconfig
if SHIELD_CYGNUS_R

config ZMK_KEYBOARD_NAME
    default "Cygnus_R"

config ZMK_SPLIT
    default y

config ZMK_SPLIT_ROLE_CENTRAL
    default y

config ZMK_BLE
    default y

config INPUT
    default y

config ZMK_POINTING
    default y

config SPI
    default y

config PMW3610
    default y

endif

if SHIELD_CYGNUS_L

config ZMK_KEYBOARD_NAME
    default "Cygnus_L"

config ZMK_SPLIT
    default y

endif

if SHIELD_CYGNUS_R || SHIELD_CYGNUS_L

config NFCT_PINS_AS_GPIOS
    default y

endif
```

## config/west.yml
```yaml
manifest:
  remotes:
    - name: zmkfirmware
      url-base: https://github.com/zmkfirmware
    - name: badjeff
      url-base: https://github.com/badjeff
    - name: caksoylar
      url-base: https://github.com/caksoylar
    - name: zettaface
      url-base: https://github.com/zettaface

  projects:
    - name: zmk
      remote: zmkfirmware
      revision: v0.3
      import: app/west.yml
    - name: zmk-pmw3610-driver
      remote: badjeff
      revision: zmk-0.3
      path: modules/zmk-pmw3610-driver
    - name: zmk-rgbled-widget
      remote: caksoylar
      revision: v0.3
    - name: zmk-input-processor-keybind
      remote: zettaface
      revision: main

  self:
    path: config
```
